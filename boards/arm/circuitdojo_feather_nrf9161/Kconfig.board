## boards/arm/circuitdojo_feather_nrf9161/Kconfig.board
```kconfig
# Circuit Dojo nRF9161 Feather configuration

# Copyright (c) 2018-2024 Nordic Semiconductor ASA
# Copyright (c) 2020-2024 Circuit Dojo LLC
# SPDX-License-Identifier: Apache-2.0

if SOC_NRF9161_LACA

config BOARD_CIRCUITDOJO_FEATHER_NRF9161
	bool "Circuit Dojo nRF9161 Feather"

config BOARD_CIRCUITDOJO_FEATHER_NRF9161_NS
	bool "Circuit Dojo nRF9161 Feather non-secure"

config BOARD_CIRCUITDOJO_FEATHER_NRF9161_PMIC_STARTUP
	bool "Allows for executing startup code for PMIC."

endif # SOC_NRF9161_LACA
```

## boards/circuitdojo/feather_nrf9161/board.yml
```yaml
board:
  name: circuitdojo_feather_nrf9161
  vendor: circuitdojo
  socs:
    - name: nrf9161
      variants:
        - name: ns
  revision:
    format: major.minor.patch
    default: "1.0.0"
    revisions:
      - name: "1.0.0"
```

## samples/at_client/boards/circuitdojo_feather_nrf9161_ns.conf
```kconfig
# Multithread
CONFIG_MULTITHREADING=y

# SPI
CONFIG_SPI=y
CONFIG_SPI_NOR=y

# PMIC 
CONFIG_MFD=y
CONFIG_MFD_NPM1300=y
```
