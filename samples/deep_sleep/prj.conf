## prj.conf
```kconfig
# Stacks and heaps
CONFIG_MAIN_STACK_SIZE=4096
CONFIG_HEAP_MEM_POOL_SIZE=16384

CONFIG_DEBUG=n

# Add the accelerometer
CONFIG_I2C=y
CONFIG_SENSOR=y
CONFIG_LIS2DH=y
CONFIG_LIS2DH_TRIGGER_GLOBAL_THREAD=y
CONFIG_LIS2DH_ODR_RUNTIME=y

# SPI Flash
CONFIG_SPI=y
CONFIG_SPI_NOR=y
CONFIG_SPI_NOR_FLASH_LAYOUT_PAGE_SIZE=4096
CONFIG_SPI_NOR_IDLE_IN_DPD=y

# Enable flash operations.
CONFIG_FLASH=y
CONFIG_FLASH_MAP=y
CONFIG_FLASH_PAGE_LAYOUT=y

CONFIG_LOG=y
CONFIG_LOG_PRINTK=y

# Zephyr Device Power Management
CONFIG_PM_DEVICE=y

# Network
CONFIG_NETWORKING=y
CONFIG_NET_SOCKETS=y
CONFIG_NET_NATIVE=n
CONFIG_NET_SOCKETS_POSIX_NAMES=y

# LTE link control
CONFIG_LTE_LINK_CONTROL=y

# Modem library
CONFIG_NRF_MODEM_LIB=y
CONFIG_NRF_MODEM_LIB_TRACE=n

# PSM & eDRX enable
CONFIG_LTE_EDRX_REQ=y
CONFIG_LTE_PSM_REQ=y

# Async
CONFIG_UART_ASYNC_API=y
CONFIG_UART_LINE_CTRL=y
```

## src/main.c
```c
/*
 * Copyright (c) 2024 Circuit Dojo LLC
 *
 * SPDX-License-Identifier: Apache-2.0
 */
#include <zephyr/drivers/mfd/npm1300.h>
#include <zephyr/kernel.h>
#include <zephyr/sys/printk.h>

#define SHIP_BASE 0x0BU
#define SHIP_OFFSET_TASKENTERSHIPMODE 0x02U

/* Addresses */
#define NPM1300_BUCK_BASE 0x04U
#define NPM1300_BUCK_OFFSET_EN_CLR 0x01U
#define NPM1300_BUCK_BUCKCTRL0 0x15U
#define NPM1300_BUCK_STATUS 0x34U

int main(void) {

  printk("Deep sleep sample\n");

#if defined(CONFIG_BOARD_CIRCUITDOJO_FEATHER_NRF9161)
  static const struct device *pmic = DEVICE_DT_GET(DT_NODELABEL(npm1300_pmic));

  int ret;
  uint8_t reg = 0;

  /* See if pulldown is not already enabled */
  ret = mfd_npm1300_reg_read(pmic, NPM1300_BUCK_BASE, NPM1300_BUCK_BUCKCTRL0,
                             &reg);
  if (ret < 0)
    printk("Failed to set VBUSINLIM. Err: %d\n", ret);

  if ((reg & 0x08) == 0) {

    /* Write to MFD to enable pulldown for both Bucks */
    ret = mfd_npm1300_reg_write(pmic, NPM1300_BUCK_BASE, NPM1300_BUCK_BUCKCTRL0,
                                0x08 + 0x04);
    if (ret < 0)
      printk("Failed to set VBUSINLIM. Err: %d\n", ret);
  }

#if false
    /* set hibernate mode and power down */
    ret = mfd_npm1300_hibernate(pmic, 60000);
    if (ret < 0) {
      printk("Failed to hibernate. Err: %d\n", ret);
      return ret;
    }
#else
  /* Put into ship mode */
  ret =
      mfd_npm1300_reg_write(pmic, SHIP_BASE, SHIP_OFFSET_TASKENTERSHIPMODE, 1U);
  if (ret < 0) {
    printk("Failed to go into ship mode. Err: %i\n", ret);
    return ret;
  }
#endif

#else
#error Sample not supported on this board
#endif

  return 0;
}
```
