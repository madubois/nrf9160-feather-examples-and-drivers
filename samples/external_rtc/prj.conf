## prj.conf
```kconfig
CONFIG_GPIO=y

# Log
CONFIG_LOG=y
CONFIG_LOG_MODE_IMMEDIATE=y

# Adding Peripherals
CONFIG_I2C=y

# RTC
CONFIG_COUNTER=y
CONFIG_PCF85063A=y
```

## src/main.c
```c
/*
 * Copyright (c) 2020 Circuit Dojo LLC
 *
 * SPDX-License-Identifier: Apache-2.0
 */

#include <zephyr/kernel.h>
#include <zephyr/device.h>
#include <zephyr/drivers/gpio.h>
#include <zephyr/sys/util.h>
#include <zephyr/sys/printk.h>
#include <zephyr/drivers/counter.h>

#include <zephyr/logging/log.h>
LOG_MODULE_REGISTER(main);

#if defined(CONFIG_BOARD_CIRCUITDOJO_FEATHER_NRF9160_NRF9160_NS)
static const struct device *rtc = DEVICE_DT_GET(DT_ALIAS(rtc0));

/* RTC control */
static void rtc_init()
{

	/* Check if ready*/
	if (!device_is_ready(rtc))
	{
		LOG_ERR("RTC is not ready!");
	}

	/* 2 seconds */
	const struct counter_alarm_cfg cfg = {
		.ticks = 10,
	};

	/* Set the alarm */
	int ret = counter_set_channel_alarm(rtc, 0, &cfg);
	if (ret)
	{
		LOG_ERR("Unable to set alarm");
	}
}

static bool timer_flag = false;

int main(void)
{

	/* Init RTC */
	rtc_init();

	while (true)
	{
		if (!timer_flag)
		{
			int ret = counter_get_pending_int(rtc);

			if (ret == 1)
			{
				LOG_INF("Timer event!");

				timer_flag = true;

				int ret = counter_cancel_channel_alarm(rtc, 0);
				if (ret)
				{
					LOG_ERR("Unable to cancel channel alarm!");
				}
			}
		}

		k_sleep(K_MSEC(100));
	}

	return 0;
}
#else
#error "Unsupported board"
#endif
```
