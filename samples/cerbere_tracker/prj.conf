## Kconfig
```
config DISABLE_CONSOLE_ON_BOOT
	bool "Disable console on start for power savings"
	default n

rsource "src/gps/Kconfig"
rsource "src/shell/Kconfig"
rsource "src/version/Kconfig"

source "Kconfig.zephyr"
```

## prj.conf
```kconfig
# General config
CONFIG_ASSERT=y

# Logging & Console
CONFIG_CONSOLE=y
CONFIG_LOG=y

# Network
CONFIG_NETWORKING=y
CONFIG_NET_NATIVE=n
CONFIG_NET_SOCKETS=y

# LTE link control
CONFIG_LTE_LINK_CONTROL=y
CONFIG_LTE_NETWORK_MODE_LTE_M_NBIOT_GPS=y

# PSM & eDRX enable
CONFIG_LTE_EDRX_REQ=y
CONFIG_LTE_PSM_REQ=y
CONFIG_LTE_PSM_REQ_RPTAU="00000001" # 10 min
CONFIG_LTE_PSM_REQ_RAT="00000011" # 6 sec active time
CONFIG_LTE_LC_TAU_PRE_WARNING_NOTIFICATIONS=y
CONFIG_LTE_LC_TAU_PRE_WARNING_THRESHOLD_MS=60000
CONFIG_LTE_LC_MODEM_SLEEP_NOTIFICATIONS=y
CONFIG_LTE_LC_MODEM_SLEEP_NOTIFICATIONS_THRESHOLD_MS=60000

# Modem library
CONFIG_NRF_MODEM_LIB=y
CONFIG_NRF_MODEM_LIB_TRACE=n

# Golioth
CONFIG_GOLIOTH=y
CONFIG_GOLIOTH_SETTINGS=y
CONFIG_GOLIOTH_SYSTEM_CLIENT=y
CONFIG_GOLIOTH_SYSTEM_CLIENT_RX_TIMEOUT_SEC=660
CONFIG_GOLIOTH_SYSTEM_CLIENT_PING_INTERVAL_SEC=600
CONFIG_GOLIOTH_CIPHERSUITES="TLS_PSK_WITH_AES_128_CBC_SHA256"

# Disable options y-selected by NCS for no good reason
CONFIG_MBEDTLS_KEY_EXCHANGE_DHE_PSK_ENABLED=n
CONFIG_MBEDTLS_KEY_EXCHANGE_DHE_RSA_ENABLED=n

# Shell
CONFIG_SHELL=y
CONFIG_SHELL_WILDCARD=n
CONFIG_SHELL_AT_CMD=y

# Enable flash
CONFIG_FLASH=y
CONFIG_FLASH_MAP=y
CONFIG_FLASH_PAGE_LAYOUT=y

# Enable bootloader
CONFIG_BOOTLOADER_MCUBOOT=y
CONFIG_IMG_MANAGER=y
CONFIG_STREAM_FLASH=y
CONFIG_MCUBOOT_IMG_MANAGER=y
CONFIG_IMG_ERASE_PROGRESSIVELY=y

# Stacks and heaps
CONFIG_MAIN_STACK_SIZE=3072
CONFIG_HEAP_MEM_POOL_SIZE=4096

# Power management
CONFIG_PM_DEVICE=y

# Date time
CONFIG_DATE_TIME=y

# Cbor
CONFIG_ZCBOR=y

# Settings
CONFIG_SETTINGS=y
CONFIG_SETTINGS_RUNTIME=y

# Modem information
CONFIG_MODEM_INFO=y

# Enable ADC
CONFIG_ADC=y

# SUPL
# CONFIG_SUPL_CLIENT_LIB=y

# DEBUG
CONFIG_LOG_DEFAULT_LEVEL=3




CONFIG_GNSS_SAMPLE_PERIODIC_TIMEOUT=1200


# GPS Antenna configuration
CONFIG_MODEM_ANTENNA=y
CONFIG_MODEM_ANTENNA_AT_COEX0="AT\%XCOEX0=1,1,1565,1586"
```

## src/main.c
```c
/*
 * Copyright Circuit Dojo (c) 2023
 *
 * SPDX-License-Identifier: Apache-2.0
 */

#include <zephyr/drivers/gpio.h>
#include <zephyr/pm/device.h>
#include <zephyr/logging/log.h>
LOG_MODULE_REGISTER(app);

/* nRF Libraries */
#include <modem/lte_lc.h>
#include <modem/modem_info.h>
#include <modem/nrf_modem_lib.h>

/* Local */
#include <app_backend.h>
#include <app_gps.h>

int main(void)
{
	int err;

	LOG_INF("Starting tracker on %s!", CONFIG_BOARD);

	/* Init modem library */
	err = nrf_modem_lib_init();
	if (err < 0)
		__ASSERT_MSG_INFO("Unable to initialize modem lib. (err: %i)", err);

#if IS_ENABLED(CONFIG_DISABLE_CONSOLE_ON_BOOT)

	/* MD button setup  */
	const struct gpio_dt_spec button =
		GPIO_DT_SPEC_GET_BY_IDX(DT_ALIAS(sw0), gpios, 0);

	/* Init button */
	gpio_pin_configure_dt(&button, GPIO_INPUT);

	/* Check button */
	k_sleep(K_SECONDS(2));

	/* Check if button is being pressed to remain active */
	if (!gpio_pin_get_dt(&button))
	{
		static const struct device *const console_dev =
			DEVICE_DT_GET(DT_CHOSEN(zephyr_console));

		/* Disable console UART */
		err = pm_device_action_run(console_dev, PM_DEVICE_ACTION_SUSPEND);
		if (err)
		{
			LOG_ERR("Unable to suspend console UART. (err: %d)", err);
			return err;
		}
	}
#endif

	err = lte_lc_init();
	if (err < 0)
		__ASSERT_MSG_INFO("LTE init failed. (err: %i)", err);

	/* Power saving is turned on */
	err = lte_lc_psm_req(true);
	if (err < 0)
		__ASSERT_MSG_INFO("PSM request failed. (err: %i)", err);

	/* Edrx is turned on */
	err = lte_lc_edrx_req(true);
	if (err < 0)
		__ASSERT_MSG_INFO("eDRX request failed. (err: %i)", err);

	/* Connect to LTE */
	err = lte_lc_connect();
	if (err < 0)
		__ASSERT_MSG_INFO("LTE connect failed. (err: %i)", err);

	/* Set up modem info */
	err = modem_info_init();
	if (err < 0)
		__ASSERT_MSG_INFO("Unable to initialize modem info. (err: %i)", err);

	/* Get the IMEI (used for client ID)*/
	char imei[20] = {0};
	err = modem_info_string_get(MODEM_INFO_IMEI, imei, sizeof(imei));
	if (err < 0)
	{
		__ASSERT_MSG_INFO("Unable to get IMEI. Err: %i", err);
	}
	else
	{
		imei[15] = '\0';
	}

	LOG_INF("IMEI: %s", (char *)(imei));

	/* Init backend */
	err = app_backend_init(imei, strlen(imei));
	if (err < 0)
		__ASSERT_MSG_INFO("Unable to initialize backend. (err: %i)", err);

	/* Setup gps */
	err = app_gps_setup();
	if (err < 0)
		__ASSERT_MSG_INFO("Unable to setup GPS. Err: %i", err);

	LOG_INF("XXXXXXXXXXXXXXXXXXXXXXXXXXXXXXXXXXXXXXXXXXXXXX");


	return 0;
}
```
